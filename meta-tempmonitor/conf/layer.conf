## meta-tempmonitor/conf/layer.conf
```bitbake
# We have a conf and classes directory, add to BBPATH
BBPATH .= ":${LAYERDIR}"

# We have recipes-* directories, add to BBFILES
BBFILES += "${LAYERDIR}/recipes-*/*/*.bb \
            ${LAYERDIR}/recipes-*/*/*.bbappend"

BBFILE_COLLECTIONS += "meta-tempcontrol"
BBFILE_PATTERN_meta-tempcontrol = "^${LAYERDIR}/"
BBFILE_PRIORITY_meta-tempcontrol = "6"

LAYERDEPENDS_meta-tempcontrol = "core"
LAYERSERIES_COMPAT_meta-tempcontrol = "scarthgap"

LICENSE_FLAGS_ACCEPTED = "synaptics-killswitch"
```
